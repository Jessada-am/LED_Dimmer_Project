
; PICBASIC PRO(TM) Compiler 2.60C, (c) 1998, 2011 microEngineering Labs, Inc. All Rights Reserved. 
MPASMWIN_USED			EQU	1

	INCLUDE	"C:\PBP260\16F886.INC"


; Define statements.
; C:\PBP260\16F886.BAS     	00018	DEFINE  CODE_SIZE 8
#define		CODE_SIZE		 8
; C:\USERS\JESSADA\DESKTOP\LED DIMMER PROJECT\PIC16F886\MB_STDIM.BAS	00011	DEFINE	OSC 20		; 20 MHZ
#define		OSC		 20		; 20 MHZ
; C:\USERS\JESSADA\DESKTOP\LED DIMMER PROJECT\PIC16F886\MB_STDIM.BAS	00013	DEFINE  DEBUG_REG   PORTB	'
#define		DEBUG_REG		   PORTB	
; C:\USERS\JESSADA\DESKTOP\LED DIMMER PROJECT\PIC16F886\MB_STDIM.BAS	00014	DEFINE  DEBUG_BIT   3            
#define		DEBUG_BIT		   3            
; C:\USERS\JESSADA\DESKTOP\LED DIMMER PROJECT\PIC16F886\MB_STDIM.BAS	00015	DEFINE  DEBUG_BAUD  57600	' Baudrate = 9600 bps <8N1>
#define		DEBUG_BAUD		  57600	
; C:\USERS\JESSADA\DESKTOP\LED DIMMER PROJECT\PIC16F886\MB_STDIM.BAS	00016	DEFINE  DEBUG_MODE  0       ' Non-invert mode <drive through MAX232> 
#define		DEBUG_MODE		  0       
; C:\USERS\JESSADA\DESKTOP\LED DIMMER PROJECT\PIC16F886\MB_STDIM.BAS	00020	DEFINE	LCD
#define		LCD		
; C:\USERS\JESSADA\DESKTOP\LED DIMMER PROJECT\PIC16F886\MB_STDIM.BAS	00023	DEFINE LCD_DREG PORTB     ' LCD data port 
#define		LCD_DREG		 PORTB     
; C:\USERS\JESSADA\DESKTOP\LED DIMMER PROJECT\PIC16F886\MB_STDIM.BAS	00024	DEFINE LCD_DBIT 4         ' LCD data starting bit 0 or 4 
#define		LCD_DBIT		 4         
; C:\USERS\JESSADA\DESKTOP\LED DIMMER PROJECT\PIC16F886\MB_STDIM.BAS	00025	DEFINE LCD_RSREG PORTC    ' LCD register select port 
#define		LCD_RSREG		 PORTC    
; C:\USERS\JESSADA\DESKTOP\LED DIMMER PROJECT\PIC16F886\MB_STDIM.BAS	00026	DEFINE LCD_RSBIT 1        ' LCD register select bit 
#define		LCD_RSBIT		 1        
; C:\USERS\JESSADA\DESKTOP\LED DIMMER PROJECT\PIC16F886\MB_STDIM.BAS	00027	DEFINE LCD_EREG PORTC     ' LCD enable port 
#define		LCD_EREG		 PORTC     
; C:\USERS\JESSADA\DESKTOP\LED DIMMER PROJECT\PIC16F886\MB_STDIM.BAS	00028	DEFINE LCD_EBIT 0         ' LCD enable bit 
#define		LCD_EBIT		 0         
; C:\USERS\JESSADA\DESKTOP\LED DIMMER PROJECT\PIC16F886\MB_STDIM.BAS	00029	DEFINE LCD_BITS 4         ' LCD bus size 4 or 8 
#define		LCD_BITS		 4         
; C:\USERS\JESSADA\DESKTOP\LED DIMMER PROJECT\PIC16F886\MB_STDIM.BAS	00030	DEFINE LCD_LINES 2        ' Number lines on LCD 
#define		LCD_LINES		 2        
; C:\USERS\JESSADA\DESKTOP\LED DIMMER PROJECT\PIC16F886\MB_STDIM.BAS	00031	DEFINE LCD_COMMANDUS 2000 ' Command delay time in us 
#define		LCD_COMMANDUS		 2000 
; C:\USERS\JESSADA\DESKTOP\LED DIMMER PROJECT\PIC16F886\MB_STDIM.BAS	00032	DEFINE LCD_DATAUS 50      ' Data delay time in us
#define		LCD_DATAUS		 50      
; C:\USERS\JESSADA\DESKTOP\LED DIMMER PROJECT\PIC16F886\MB_STDIM.BAS	00054	define  INTHAND Int_prog
#define		INTHAND		 Int_prog

RAM_START       		EQU	00020h
RAM_END         		EQU	001EFh
RAM_BANKS       		EQU	00004h
BANK0_START     		EQU	00020h
BANK0_END       		EQU	0007Fh
BANK1_START     		EQU	000A0h
BANK1_END       		EQU	000EFh
BANK2_START     		EQU	00110h
BANK2_END       		EQU	0016Fh
BANK3_START     		EQU	00190h
BANK3_END       		EQU	001EFh
EEPROM_START    		EQU	02100h
EEPROM_END      		EQU	021FFh

; C:\PBP260\PBPPIC14.RAM   	00012	A00020	R0      VAR     WORD BANK0 SYSTEM       ' System Register
R0              		EQU	RAM_START + 000h
; C:\PBP260\PBPPIC14.RAM   	00013	A00022	R1      VAR     WORD BANK0 SYSTEM       ' System Register
R1              		EQU	RAM_START + 002h
; C:\PBP260\PBPPIC14.RAM   	00014	A00024	R2      VAR     WORD BANK0 SYSTEM       ' System Register
R2              		EQU	RAM_START + 004h
; C:\PBP260\PBPPIC14.RAM   	00015	A00026	R3      VAR     WORD BANK0 SYSTEM       ' System Register
R3              		EQU	RAM_START + 006h
; C:\PBP260\PBPPIC14.RAM   	00016	A00028	R4      VAR     WORD BANK0 SYSTEM       ' System Register
R4              		EQU	RAM_START + 008h
; C:\PBP260\PBPPIC14.RAM   	00017	A0002A	R5      VAR     WORD BANK0 SYSTEM       ' System Register
R5              		EQU	RAM_START + 00Ah
; C:\PBP260\PBPPIC14.RAM   	00018	A0002C	R6      VAR     WORD BANK0 SYSTEM       ' System Register
R6              		EQU	RAM_START + 00Ch
; C:\PBP260\PBPPIC14.RAM   	00019	A0002E	R7      VAR     WORD BANK0 SYSTEM       ' System Register
R7              		EQU	RAM_START + 00Eh
; C:\PBP260\PBPPIC14.RAM   	00020	A00030	R8      VAR     WORD BANK0 SYSTEM       ' System Register
R8              		EQU	RAM_START + 010h
; C:\PBP260\PBPPIC14.RAM   	00026	A00032	FLAGS   VAR     BYTE BANK0 SYSTEM       ' Static flags
FLAGS           		EQU	RAM_START + 012h
; C:\PBP260\PBPPIC14.RAM   	00025	A00033	GOP     VAR     BYTE BANK0 SYSTEM       ' Gen Op Parameter
GOP             		EQU	RAM_START + 013h
; C:\PBP260\PBPPIC14.RAM   	00022	A00034	RM1     VAR     BYTE BANK0 SYSTEM       ' Pin 1 Mask
RM1             		EQU	RAM_START + 014h
; C:\PBP260\PBPPIC14.RAM   	00024	A00035	RM2     VAR     BYTE BANK0 SYSTEM       ' Pin 2 Mask
RM2             		EQU	RAM_START + 015h
; C:\PBP260\PBPPIC14.RAM   	00021	A00036	RR1     VAR     BYTE BANK0 SYSTEM       ' Pin 1 Register
RR1             		EQU	RAM_START + 016h
; C:\PBP260\PBPPIC14.RAM   	00023	A00037	RR2     VAR     BYTE BANK0 SYSTEM       ' Pin 2 Register
RR2             		EQU	RAM_START + 017h
; C:\USERS\JESSADA\DESKTOP\LED DIMMER PROJECT\PIC16F886\MB_STDIM.BAS	00129	A00038	ix		var	word
_ix              		EQU	RAM_START + 018h
; C:\USERS\JESSADA\DESKTOP\LED DIMMER PROJECT\PIC16F886\MB_STDIM.BAS	00127	A0003A	secCnt	var WORD
_secCnt          		EQU	RAM_START + 01Ah
; C:\USERS\JESSADA\DESKTOP\LED DIMMER PROJECT\PIC16F886\MB_STDIM.BAS	00001	A0003C	
T1              		EQU	RAM_START + 01Ch
; C:\USERS\JESSADA\DESKTOP\LED DIMMER PROJECT\PIC16F886\MB_STDIM.BAS	00133	A0003E	d		var	byte
_d               		EQU	RAM_START + 01Eh
; C:\USERS\JESSADA\DESKTOP\LED DIMMER PROJECT\PIC16F886\MB_STDIM.BAS	00134	A0003F	d1		var	byte
_d1              		EQU	RAM_START + 01Fh
; C:\USERS\JESSADA\DESKTOP\LED DIMMER PROJECT\PIC16F886\MB_STDIM.BAS	00135	A00040	d2		var	byte
_d2              		EQU	RAM_START + 020h
; C:\USERS\JESSADA\DESKTOP\LED DIMMER PROJECT\PIC16F886\MB_STDIM.BAS	00136	A00041	d3		var	byte
_d3              		EQU	RAM_START + 021h
; C:\USERS\JESSADA\DESKTOP\LED DIMMER PROJECT\PIC16F886\MB_STDIM.BAS	00140	A00042	DatRcv_Fg	var	byte
_DatRcv_Fg       		EQU	RAM_START + 022h
; C:\USERS\JESSADA\DESKTOP\LED DIMMER PROJECT\PIC16F886\MB_STDIM.BAS	00121	A00043	i		var	byte
_i               		EQU	RAM_START + 023h
; C:\USERS\JESSADA\DESKTOP\LED DIMMER PROJECT\PIC16F886\MB_STDIM.BAS	00122	A00044	j		var	byte
_j               		EQU	RAM_START + 024h
; C:\USERS\JESSADA\DESKTOP\LED DIMMER PROJECT\PIC16F886\MB_STDIM.BAS	00123	A00045	k		var	byte
_k               		EQU	RAM_START + 025h
; C:\USERS\JESSADA\DESKTOP\LED DIMMER PROJECT\PIC16F886\MB_STDIM.BAS	00126	A00046	kcnt	var	byte
_kcnt            		EQU	RAM_START + 026h
; C:\USERS\JESSADA\DESKTOP\LED DIMMER PROJECT\PIC16F886\MB_STDIM.BAS	00124	A00047	l		var	byte
_l               		EQU	RAM_START + 027h
; C:\USERS\JESSADA\DESKTOP\LED DIMMER PROJECT\PIC16F886\MB_STDIM.BAS	00125	A00048	m		var	byte
_m               		EQU	RAM_START + 028h
; C:\USERS\JESSADA\DESKTOP\LED DIMMER PROJECT\PIC16F886\MB_STDIM.BAS	00119	A00049	p		var	byte
_p               		EQU	RAM_START + 029h
; C:\USERS\JESSADA\DESKTOP\LED DIMMER PROJECT\PIC16F886\MB_STDIM.BAS	00150	A0004A	Rpt		var	byte
_Rpt             		EQU	RAM_START + 02Ah
; C:\USERS\JESSADA\DESKTOP\LED DIMMER PROJECT\PIC16F886\MB_STDIM.BAS	00118	A0004B	w		var	byte
_w               		EQU	RAM_START + 02Bh
; C:\USERS\JESSADA\DESKTOP\LED DIMMER PROJECT\PIC16F886\MB_STDIM.BAS	00116	A0004C	x 		var byte
_x               		EQU	RAM_START + 02Ch
; C:\USERS\JESSADA\DESKTOP\LED DIMMER PROJECT\PIC16F886\MB_STDIM.BAS	00117	A0004D	y		var	byte
_y               		EQU	RAM_START + 02Dh
; C:\USERS\JESSADA\DESKTOP\LED DIMMER PROJECT\PIC16F886\MB_STDIM.BAS	00106	A00070	temp	var	byte $70
_temp            		EQU	RAM_START + 050h
; C:\USERS\JESSADA\DESKTOP\LED DIMMER PROJECT\PIC16F886\MB_STDIM.BAS	00107	A00071	temp1	var	byte $71
_temp1           		EQU	RAM_START + 051h
; C:\USERS\JESSADA\DESKTOP\LED DIMMER PROJECT\PIC16F886\MB_STDIM.BAS	00108	A00072	temp2	var	byte $72
_temp2           		EQU	RAM_START + 052h
; C:\USERS\JESSADA\DESKTOP\LED DIMMER PROJECT\PIC16F886\MB_STDIM.BAS	00109	A00073	temp3	var	byte $73
_temp3           		EQU	RAM_START + 053h
; C:\USERS\JESSADA\DESKTOP\LED DIMMER PROJECT\PIC16F886\MB_STDIM.BAS	00110	A00074	temp4	var	byte $74
_temp4           		EQU	RAM_START + 054h
; C:\USERS\JESSADA\DESKTOP\LED DIMMER PROJECT\PIC16F886\MB_STDIM.BAS	00111	A00075	temp5	var	byte $75
_temp5           		EQU	RAM_START + 055h
; C:\USERS\JESSADA\DESKTOP\LED DIMMER PROJECT\PIC16F886\MB_STDIM.BAS	00112	A00076	temp6	var	byte $76
_temp6           		EQU	RAM_START + 056h
; C:\USERS\JESSADA\DESKTOP\LED DIMMER PROJECT\PIC16F886\MB_STDIM.BAS	00113	A00077	temp7	var	byte $77
_temp7           		EQU	RAM_START + 057h
; C:\USERS\JESSADA\DESKTOP\LED DIMMER PROJECT\PIC16F886\MB_STDIM.BAS	00143	A00078	charCnt var	byte $78
_charCnt         		EQU	RAM_START + 058h
; C:\USERS\JESSADA\DESKTOP\LED DIMMER PROJECT\PIC16F886\MB_STDIM.BAS	00144	A00079	dlyCnt	var	byte $79
_dlyCnt          		EQU	RAM_START + 059h
; C:\USERS\JESSADA\DESKTOP\LED DIMMER PROJECT\PIC16F886\MB_STDIM.BAS	00145	A0007A	Dat		var	byte $7a
_Dat             		EQU	RAM_START + 05Ah
; C:\USERS\JESSADA\DESKTOP\LED DIMMER PROJECT\PIC16F886\MB_STDIM.BAS	00147	A0007D	wsave  	var byte $7d system
wsave           		EQU	RAM_START + 05Dh
; C:\USERS\JESSADA\DESKTOP\LED DIMMER PROJECT\PIC16F886\MB_STDIM.BAS	00148	A0007E	ssave  	var byte $7e system
ssave           		EQU	RAM_START + 05Eh
; C:\USERS\JESSADA\DESKTOP\LED DIMMER PROJECT\PIC16F886\MB_STDIM.BAS	00149	A0007F	psave  	var byte $7f system
psave           		EQU	RAM_START + 05Fh
; C:\USERS\JESSADA\DESKTOP\LED DIMMER PROJECT\PIC16F886\MB_STDIM.BAS	00089	A000A0	commBuf		var byte[32] $a0
_commBuf         		EQU	RAM_START + 080h
; C:\USERS\JESSADA\DESKTOP\LED DIMMER PROJECT\PIC16F886\MB_STDIM.BAS	00090	A000C0	intBuffer	var byte[16] $c0	
_intBuffer       		EQU	RAM_START + 0A0h
; C:\USERS\JESSADA\DESKTOP\LED DIMMER PROJECT\PIC16F886\MB_STDIM.BAS	00097	A00120	txB 		var byte[60] $120
_txB             		EQU	RAM_START + 00100h
; C:\USERS\JESSADA\DESKTOP\LED DIMMER PROJECT\PIC16F886\MB_STDIM.BAS	00098	A00190	rxB			var	byte[60] $190
_rxB             		EQU	RAM_START + 00170h
; C:\USERS\JESSADA\DESKTOP\LED DIMMER PROJECT\PIC16F886\MB_STDIM.BAS	00092	grp			var	intBuffer[1]
_grp             		EQU	_intBuffer + 001h
; C:\USERS\JESSADA\DESKTOP\LED DIMMER PROJECT\PIC16F886\MB_STDIM.BAS	00093	cmd			var	intBuffer[2]
_cmd             		EQU	_intBuffer + 002h
; C:\USERS\JESSADA\DESKTOP\LED DIMMER PROJECT\PIC16F886\MB_STDIM.BAS	00094	scr_val		var	intBuffer[3]
_scr_val         		EQU	_intBuffer + 003h
; C:\USERS\JESSADA\DESKTOP\LED DIMMER PROJECT\PIC16F886\MB_STDIM.BAS	00095	val			var	intBuffer[4]
_val             		EQU	_intBuffer + 004h
; C:\PBP260\16F886.BAS     	00022	PORTL   VAR     PORTB
_PORTL           		EQU	 PORTB
; C:\PBP260\16F886.BAS     	00023	PORTH   VAR     PORTC
_PORTH           		EQU	 PORTC
; C:\PBP260\16F886.BAS     	00024	TRISL   VAR     TRISB
_TRISL           		EQU	 TRISB
; C:\PBP260\16F886.BAS     	00025	TRISH   VAR     TRISC
_TRISH           		EQU	 TRISC
#define _P_SI            	_PORTB??5
#define _P_SCLK          	_PORTB??4
#define _P_SO            	_PORTB??3
#define _P_GD0           	_PORTB??2
#define _P_CS            	_PORTB??1
#define _TX_EN           	_PORTB??0
#define _rx_loc          	_PORTA??2
#define _txen_loc        	_PORTA??1
#define _tx_loc          	_PORTA??0
#define _led1            	_PORTA??3
#define _rst             	_PORTC??4
#define _TMR1IF          	_PIR1??0
#define _TXIF            	_PIR1??4
#define _TMR1ON          	_T1CON??0
#define _TXEN            	_TXSTA??5
#define _BRGH            	_TXSTA??2
#define _SYNC            	_TXSTA??4
#define _SPEN            	_RCSTA??7
#define _CREN            	_RCSTA??4
#define _BRG16           	_BAUDCTL??3
#define _RCIE            	_PIE1??5
#define _TXIE            	_PIE1??4
#define _RCIF            	_PIR1??5
#define _GIE             	_INTCON??7
#define _PEIE            	_INTCON??6
#define _INTE            	_INTCON??4
#define _RBIE            	_INTCON??3
#define _RBIF            	_INTCON??0
#define _DataRdy         	_DatRcv_Fg??7
#define _PORTB??5        	 PORTB, 005h
#define _PORTB??4        	 PORTB, 004h
#define _PORTB??3        	 PORTB, 003h
#define _PORTB??2        	 PORTB, 002h
#define _PORTB??1        	 PORTB, 001h
#define _PORTB??0        	 PORTB, 000h
#define _PORTA??2        	 PORTA, 002h
#define _PORTA??1        	 PORTA, 001h
#define _PORTA??0        	 PORTA, 000h
#define _PORTA??3        	 PORTA, 003h
#define _PORTC??4        	 PORTC, 004h
#define _PIR1??0         	 PIR1, 000h
#define _PIR1??4         	 PIR1, 004h
#define _T1CON??0        	 T1CON, 000h
#define _TXSTA??5        	 TXSTA, 005h
#define _TXSTA??2        	 TXSTA, 002h
#define _TXSTA??4        	 TXSTA, 004h
#define _RCSTA??7        	 RCSTA, 007h
#define _RCSTA??4        	 RCSTA, 004h
#define _BAUDCTL??3      	 BAUDCTL, 003h
#define _PIE1??5         	 PIE1, 005h
#define _PIE1??4         	 PIE1, 004h
#define _PIR1??5         	 PIR1, 005h
#define _INTCON??7       	 INTCON, 007h
#define _INTCON??6       	 INTCON, 006h
#define _INTCON??4       	 INTCON, 004h
#define _INTCON??3       	 INTCON, 003h
#define _INTCON??0       	 INTCON, 000h
#define _DatRcv_Fg??7    	_DatRcv_Fg, 007h
#define _TRISC??7        	 TRISC, 007h
#define _TRISC??6        	 TRISC, 006h
	INCLUDE	"MB_STDIM.MAC"
	INCLUDE	"C:\PBP260\PBPPIC14.LIB"


; C:\PBP260\16F886.BAS     	00012	Z00002	BANK0   $0020, $007F
Z00002
; C:\PBP260\16F886.BAS     	00013	Z00003	BANK1   $00A0, $00EF
Z00003
; C:\PBP260\16F886.BAS     	00014	Z00004	BANK2   $0110, $016F
Z00004
; C:\PBP260\16F886.BAS     	00015	Z00005	BANK3   $0190, $01EF
Z00005
; C:\PBP260\16F886.BAS     	00016	Z00006	EEPROM  $2100, $21FF
Z00006
; C:\PBP260\16F886.BAS     	00017	Z00007	LIBRARY "PBPPIC14"
Z00007
; C:\PBP260\16F886.BAS     	00018	Z00008	DEFINE  CODE_SIZE 8
Z00008

; C:\PBP260\16F886.BAS     	00020	Z00009	        include "PIC14EXT.BAS"
Z00009

; C:\PBP260\16F886.BAS     	00027	Z0000A	        include "PBPPIC14.RAM"
Z0000A

; C:\PBP260\16F886.BAS     	00029	Z0000B		ADCON0 = $c0	' Start off with RC
Z0000B
	MOVE?CB	0C0h, ADCON0

; C:\USERS\JESSADA\DESKTOP\LED DIMMER PROJECT\PIC16F886\MB_STDIM.BAS	00008	Z0000C	@ ERRORLEVEL -306   ; turn off crossing page boundary message
Z0000C

	ASM?
 ERRORLEVEL -306   ; turn off crossing page boundary message

	ENDASM?

; C:\USERS\JESSADA\DESKTOP\LED DIMMER PROJECT\PIC16F886\MB_STDIM.BAS	00011	Z0000D	DEFINE	OSC 20		; 20 MHZ
Z0000D
; C:\USERS\JESSADA\DESKTOP\LED DIMMER PROJECT\PIC16F886\MB_STDIM.BAS	00013	Z0000E	DEFINE  DEBUG_REG   PORTB	'
Z0000E
; C:\USERS\JESSADA\DESKTOP\LED DIMMER PROJECT\PIC16F886\MB_STDIM.BAS	00014	Z0000F	DEFINE  DEBUG_BIT   3            
Z0000F
; C:\USERS\JESSADA\DESKTOP\LED DIMMER PROJECT\PIC16F886\MB_STDIM.BAS	00015	Z00010	DEFINE  DEBUG_BAUD  57600	' Baudrate = 9600 bps <8N1>
Z00010
; C:\USERS\JESSADA\DESKTOP\LED DIMMER PROJECT\PIC16F886\MB_STDIM.BAS	00016	Z00011	DEFINE  DEBUG_MODE  0       ' Non-invert mode <drive through MAX232> 
Z00011
; C:\USERS\JESSADA\DESKTOP\LED DIMMER PROJECT\PIC16F886\MB_STDIM.BAS	00020	Z00012	DEFINE	LCD
Z00012
; C:\USERS\JESSADA\DESKTOP\LED DIMMER PROJECT\PIC16F886\MB_STDIM.BAS	00023	Z00013	DEFINE LCD_DREG PORTB     ' LCD data port 
Z00013
; C:\USERS\JESSADA\DESKTOP\LED DIMMER PROJECT\PIC16F886\MB_STDIM.BAS	00024	Z00014	DEFINE LCD_DBIT 4         ' LCD data starting bit 0 or 4 
Z00014
; C:\USERS\JESSADA\DESKTOP\LED DIMMER PROJECT\PIC16F886\MB_STDIM.BAS	00025	Z00015	DEFINE LCD_RSREG PORTC    ' LCD register select port 
Z00015
; C:\USERS\JESSADA\DESKTOP\LED DIMMER PROJECT\PIC16F886\MB_STDIM.BAS	00026	Z00016	DEFINE LCD_RSBIT 1        ' LCD register select bit 
Z00016
; C:\USERS\JESSADA\DESKTOP\LED DIMMER PROJECT\PIC16F886\MB_STDIM.BAS	00027	Z00017	DEFINE LCD_EREG PORTC     ' LCD enable port 
Z00017
; C:\USERS\JESSADA\DESKTOP\LED DIMMER PROJECT\PIC16F886\MB_STDIM.BAS	00028	Z00018	DEFINE LCD_EBIT 0         ' LCD enable bit 
Z00018
; C:\USERS\JESSADA\DESKTOP\LED DIMMER PROJECT\PIC16F886\MB_STDIM.BAS	00029	Z00019	DEFINE LCD_BITS 4         ' LCD bus size 4 or 8 
Z00019
; C:\USERS\JESSADA\DESKTOP\LED DIMMER PROJECT\PIC16F886\MB_STDIM.BAS	00030	Z0001A	DEFINE LCD_LINES 2        ' Number lines on LCD 
Z0001A
; C:\USERS\JESSADA\DESKTOP\LED DIMMER PROJECT\PIC16F886\MB_STDIM.BAS	00031	Z0001B	DEFINE LCD_COMMANDUS 2000 ' Command delay time in us 
Z0001B
; C:\USERS\JESSADA\DESKTOP\LED DIMMER PROJECT\PIC16F886\MB_STDIM.BAS	00032	Z0001C	DEFINE LCD_DATAUS 50      ' Data delay time in us
Z0001C
; C:\USERS\JESSADA\DESKTOP\LED DIMMER PROJECT\PIC16F886\MB_STDIM.BAS	00054	Z0001D	define  INTHAND Int_prog
Z0001D

; C:\USERS\JESSADA\DESKTOP\LED DIMMER PROJECT\PIC16F886\MB_STDIM.BAS	00155	Z0001E	INI_0:
Z0001E

	LABEL?L	_INI_0	

; C:\USERS\JESSADA\DESKTOP\LED DIMMER PROJECT\PIC16F886\MB_STDIM.BAS	00156	Z0001F		gosub init_IO
Z0001F
	GOSUB?L	_init_IO

; C:\USERS\JESSADA\DESKTOP\LED DIMMER PROJECT\PIC16F886\MB_STDIM.BAS	00157	Z00020		gosub init_PWM
Z00020
	GOSUB?L	_init_PWM

; C:\USERS\JESSADA\DESKTOP\LED DIMMER PROJECT\PIC16F886\MB_STDIM.BAS	00158	Z00021		gosub init_EUSART
Z00021
	GOSUB?L	_init_EUSART

; C:\USERS\JESSADA\DESKTOP\LED DIMMER PROJECT\PIC16F886\MB_STDIM.BAS	00159	Z00022		OPTION_REG = %1001111		; /RAPU INTEDG T0CS T0SE PSA PS2 PS1 PS0		; for wdt,  int rising
Z00022
	MOVE?CB	04Fh, OPTION_REG

; C:\USERS\JESSADA\DESKTOP\LED DIMMER PROJECT\PIC16F886\MB_STDIM.BAS	00161	Z00023		high rst					; RST (ESP8266)
Z00023
	HIGH?T	_rst

; C:\USERS\JESSADA\DESKTOP\LED DIMMER PROJECT\PIC16F886\MB_STDIM.BAS	00162	Z00024		gosub OnTm1					;start timer
Z00024
	GOSUB?L	_OnTm1

; C:\USERS\JESSADA\DESKTOP\LED DIMMER PROJECT\PIC16F886\MB_STDIM.BAS	00163	Z00025		secCnt = 100
Z00025
	MOVE?CW	064h, _secCnt

; C:\USERS\JESSADA\DESKTOP\LED DIMMER PROJECT\PIC16F886\MB_STDIM.BAS	00165	Z00026		high PIE1.5				;ENABLE RCIE
Z00026
	HIGH?T	_PIE1??5

; C:\USERS\JESSADA\DESKTOP\LED DIMMER PROJECT\PIC16F886\MB_STDIM.BAS	00166	Z00027		INTCON=%11000000		;ENABLE GIE,PEIE			;     1 1 0 0 0 0 0 0                       
Z00027
	MOVE?CB	0C0h, INTCON

; C:\USERS\JESSADA\DESKTOP\LED DIMMER PROJECT\PIC16F886\MB_STDIM.BAS	00168	Z00028		secCnt=100
Z00028
	MOVE?CW	064h, _secCnt

; C:\USERS\JESSADA\DESKTOP\LED DIMMER PROJECT\PIC16F886\MB_STDIM.BAS	00169	Z00029		CCPR1L= 128
Z00029
	MOVE?CB	080h, CCPR1L

; C:\USERS\JESSADA\DESKTOP\LED DIMMER PROJECT\PIC16F886\MB_STDIM.BAS	00170	Z0002A		CCPR1H=0
Z0002A
	MOVE?CB	000h, CCPR1H

; C:\USERS\JESSADA\DESKTOP\LED DIMMER PROJECT\PIC16F886\MB_STDIM.BAS	00171	Z0002B		goto start
Z0002B
	GOTO?L	_start

; C:\USERS\JESSADA\DESKTOP\LED DIMMER PROJECT\PIC16F886\MB_STDIM.BAS	00177	Z0002C			asm
Z0002C

	ASM?

Int_prog:
w		equ	0
same	equ 1

; Insert interrupt code here
; Save and restore FSR and any other registers used
		bcf		STATUS,IRP		; bank 0
		bsf		PORTC,3			; START 
;	----- set start loc and max 80 char ------------
t0_ref:	movlw   0xc0
		movwf   FSR				; set FSR=0xa0

		clrwdt
		clrf	_charCnt		; clr no. char	_temp2 =_charCnt
		clrf	_DatRcv_Fg
;	------  set timer -----------------------------
t1_ref:	clrwdt					;			<-------------------------------		
		movlw   .10				; max delay count							|
		movwf   _dlyCnt			; dlyCnt									|
;	------ check data ready ----------------------							|
tm_lp:	btfsc   PIR1,5			; RCIF		<-----------------------		|
		goto    t2_ref			; yes data							|		|
;	---------- check timeout ----------------------------			|		|
		movlw	.250			;									|		|
		movwf	_temp7			;									|		|
		decfsz	_temp7,same		; <---|								|		|
		goto	$-1				; ----|								|		|
								;									|		|
		decfsz  _dlyCnt,same	; no data skip if zero  			|		|
		goto    tm_lp			; if not done then loop	------------		|
		goto    st_LocEx		; timeout exit								|
;	---------- get char ----------------------------------					|
t2_ref:	movfw   RCREG			; get data to (W)							|
		movwf	_Dat			; save at temp6								|
;	-----------------------------------------------------					|
;		write char to buffer 												|
;	-----------------------------------------------------					|
		movfw	_Dat			;											|
		movwf   INDF			; store at index pointer					|
		incf    _charCnt,same	; char counts 								|
		incf    FSR,same		; inc pointer (txBuffer+1)					|
		goto    t1_ref			; loop if not done reset timeout------------

st_LocEx:        
;	---------check numchar count ------------------------
		movf	_charCnt,same		
		bz		Int_ex
		bsf		_DatRcv_Fg,7		; set DAV on
		bcf		PORTC,3				; END 
Int_ex:
; Restore saved registers
		movf    psave, W
		movwf   PCLATH				;restore PCLATH
		swapf   ssave, W
		movwf   STATUS				;restore STATUS
		swapf   wsave, F			
		swapf   wsave, W
		retfie

		

	ENDASM?


; C:\USERS\JESSADA\DESKTOP\LED DIMMER PROJECT\PIC16F886\MB_STDIM.BAS	00240	Z0002D	start:
Z0002D

	LABEL?L	_start	

; C:\USERS\JESSADA\DESKTOP\LED DIMMER PROJECT\PIC16F886\MB_STDIM.BAS	00247	Z0002E			Lcdout $fe, 1 ' Clear LCD screen
Z0002E
	LCDOUT?C	0FEh
	LCDOUT?C	001h

; C:\USERS\JESSADA\DESKTOP\LED DIMMER PROJECT\PIC16F886\MB_STDIM.BAS	00248	Z0002F			Lcdout "Hello" ' Display Hello
Z0002F
	LCDOUT?C	048h
	LCDOUT?C	065h
	LCDOUT?C	06Ch
	LCDOUT?C	06Ch
	LCDOUT?C	06Fh

; C:\USERS\JESSADA\DESKTOP\LED DIMMER PROJECT\PIC16F886\MB_STDIM.BAS	00250	Z00030			Lcdout $fe, $c0 ' Clear LCD screen
Z00030
	LCDOUT?C	0FEh
	LCDOUT?C	0C0h

; C:\USERS\JESSADA\DESKTOP\LED DIMMER PROJECT\PIC16F886\MB_STDIM.BAS	00251	Z00031			Lcdout "PWM == ", #CCPR1L  
Z00031
	LCDOUT?C	050h
	LCDOUT?C	057h
	LCDOUT?C	04Dh
	LCDOUT?C	020h
	LCDOUT?C	03Dh
	LCDOUT?C	03Dh
	LCDOUT?C	020h
	LCDOUTD?B	CCPR1L

; C:\USERS\JESSADA\DESKTOP\LED DIMMER PROJECT\PIC16F886\MB_STDIM.BAS	00253	Z00032			debug "Not found Loop!!",13,10 
Z00032
	DEBUG?C	04Eh
	DEBUG?C	06Fh
	DEBUG?C	074h
	DEBUG?C	020h
	DEBUG?C	066h
	DEBUG?C	06Fh
	DEBUG?C	075h
	DEBUG?C	06Eh
	DEBUG?C	064h
	DEBUG?C	020h
	DEBUG?C	04Ch
	DEBUG?C	06Fh
	DEBUG?C	06Fh
	DEBUG?C	070h
	DEBUG?C	021h
	DEBUG?C	021h
	DEBUG?C	00Dh
	DEBUG?C	00Ah

; C:\USERS\JESSADA\DESKTOP\LED DIMMER PROJECT\PIC16F886\MB_STDIM.BAS	00255	Z00033			if (porta.0 == 0) then
Z00033
	CMPNE?TCL	_PORTA??0, 000h, L00001

; C:\USERS\JESSADA\DESKTOP\LED DIMMER PROJECT\PIC16F886\MB_STDIM.BAS	00256	Z00034				CCPR1L= 255
Z00034
	MOVE?CB	0FFh, CCPR1L

; C:\USERS\JESSADA\DESKTOP\LED DIMMER PROJECT\PIC16F886\MB_STDIM.BAS	00257	Z00035				hserout [255]
Z00035
	HSEROUT?C	0FFh

; C:\USERS\JESSADA\DESKTOP\LED DIMMER PROJECT\PIC16F886\MB_STDIM.BAS	00259	Z00036			endif
Z00036
	LABEL?L	L00001	

; C:\USERS\JESSADA\DESKTOP\LED DIMMER PROJECT\PIC16F886\MB_STDIM.BAS	00261	Z00037			if (porta.1 == 0) then
Z00037
	CMPNE?TCL	_PORTA??1, 000h, L00003

; C:\USERS\JESSADA\DESKTOP\LED DIMMER PROJECT\PIC16F886\MB_STDIM.BAS	00262	Z00038				CCPR1L= 1
Z00038
	MOVE?CB	001h, CCPR1L

; C:\USERS\JESSADA\DESKTOP\LED DIMMER PROJECT\PIC16F886\MB_STDIM.BAS	00263	Z00039				hserout [1]
Z00039
	HSEROUT?C	001h

; C:\USERS\JESSADA\DESKTOP\LED DIMMER PROJECT\PIC16F886\MB_STDIM.BAS	00265	Z0003A			endif
Z0003A
	LABEL?L	L00003	

; C:\USERS\JESSADA\DESKTOP\LED DIMMER PROJECT\PIC16F886\MB_STDIM.BAS	00267	Z0003B			if (porta.2 == 0) then
Z0003B
	CMPNE?TCL	_PORTA??2, 000h, L00005

; C:\USERS\JESSADA\DESKTOP\LED DIMMER PROJECT\PIC16F886\MB_STDIM.BAS	00268	Z0003C				CCPR1L= 128
Z0003C
	MOVE?CB	080h, CCPR1L

; C:\USERS\JESSADA\DESKTOP\LED DIMMER PROJECT\PIC16F886\MB_STDIM.BAS	00269	Z0003D				hserout [128]
Z0003D
	HSEROUT?C	080h

; C:\USERS\JESSADA\DESKTOP\LED DIMMER PROJECT\PIC16F886\MB_STDIM.BAS	00271	Z0003E			endif
Z0003E
	LABEL?L	L00005	

; C:\USERS\JESSADA\DESKTOP\LED DIMMER PROJECT\PIC16F886\MB_STDIM.BAS	00276	Z0003F			gosub cktmOut 
Z0003F
	GOSUB?L	_cktmOut

; C:\USERS\JESSADA\DESKTOP\LED DIMMER PROJECT\PIC16F886\MB_STDIM.BAS	00277	Z00040			if (Rpt>0) then					;  timeout
Z00040
	CMPLE?BCL	_Rpt, 000h, L00007

; C:\USERS\JESSADA\DESKTOP\LED DIMMER PROJECT\PIC16F886\MB_STDIM.BAS	00278	Z00041				debug "LOOP 1 ",13,10
Z00041
	DEBUG?C	04Ch
	DEBUG?C	04Fh
	DEBUG?C	04Fh
	DEBUG?C	050h
	DEBUG?C	020h
	DEBUG?C	031h
	DEBUG?C	020h
	DEBUG?C	00Dh
	DEBUG?C	00Ah

; C:\USERS\JESSADA\DESKTOP\LED DIMMER PROJECT\PIC16F886\MB_STDIM.BAS	00279	Z00042				gosub OnTm1 
Z00042
	GOSUB?L	_OnTm1

; C:\USERS\JESSADA\DESKTOP\LED DIMMER PROJECT\PIC16F886\MB_STDIM.BAS	00280	Z00043				if secCnt>0 then secCnt=secCnt-1
Z00043
	CMPLE?WCL	_secCnt, 000h, L00009
	SUB?WCW	_secCnt, 001h, _secCnt
	LABEL?L	L00009	

; C:\USERS\JESSADA\DESKTOP\LED DIMMER PROJECT\PIC16F886\MB_STDIM.BAS	00282	Z00044				if (secCnt==0) then
Z00044
	CMPNE?WCL	_secCnt, 000h, L00011

; C:\USERS\JESSADA\DESKTOP\LED DIMMER PROJECT\PIC16F886\MB_STDIM.BAS	00283	Z00045					secCnt=100 
Z00045
	MOVE?CW	064h, _secCnt

; C:\USERS\JESSADA\DESKTOP\LED DIMMER PROJECT\PIC16F886\MB_STDIM.BAS	00285	Z00046					 toggle porta.3				; toggle every 1 sec
Z00046
	TOGGLE?T	_PORTA??3

; C:\USERS\JESSADA\DESKTOP\LED DIMMER PROJECT\PIC16F886\MB_STDIM.BAS	00286	Z00047				endif
Z00047
	LABEL?L	L00011	

; C:\USERS\JESSADA\DESKTOP\LED DIMMER PROJECT\PIC16F886\MB_STDIM.BAS	00287	Z00048			endif
Z00048
	LABEL?L	L00007	

; C:\USERS\JESSADA\DESKTOP\LED DIMMER PROJECT\PIC16F886\MB_STDIM.BAS	00291	Z00049			If DataRdy == 1 Then				; RCIF  If receive flag then...
Z00049
	CMPNE?TCL	_DataRdy, 001h, L00013

; C:\USERS\JESSADA\DESKTOP\LED DIMMER PROJECT\PIC16F886\MB_STDIM.BAS	00292	Z0004A				low DataRdy
Z0004A
	LOW?T	_DataRdy

; C:\USERS\JESSADA\DESKTOP\LED DIMMER PROJECT\PIC16F886\MB_STDIM.BAS	00295	Z0004B				low CREN :high CREN		;reset error
Z0004B
	LOW?T	_CREN

; C:\USERS\JESSADA\DESKTOP\LED DIMMER PROJECT\PIC16F886\MB_STDIM.BAS	00295	Z0004C				low CREN :high CREN		;reset error
Z0004C
	HIGH?T	_CREN

; C:\USERS\JESSADA\DESKTOP\LED DIMMER PROJECT\PIC16F886\MB_STDIM.BAS	00296	Z0004D				if charCnt>0 then
Z0004D
	CMPLE?BCL	_charCnt, 000h, L00015

; C:\USERS\JESSADA\DESKTOP\LED DIMMER PROJECT\PIC16F886\MB_STDIM.BAS	00297	Z0004E					for j = 0 to charCnt-1
Z0004E
	MOVE?CB	000h, _j
	LABEL?L	L00017	
	SUB?BCW	_charCnt, 001h, T1
	CMPGT?BWL	_j, T1, L00018

; C:\USERS\JESSADA\DESKTOP\LED DIMMER PROJECT\PIC16F886\MB_STDIM.BAS	00298	Z0004F						d=intBuffer[j]
Z0004F
	AOUT?BBB	_intBuffer, _j, _d

; C:\USERS\JESSADA\DESKTOP\LED DIMMER PROJECT\PIC16F886\MB_STDIM.BAS	00300	Z00050						CCPR1L= d
Z00050
	MOVE?BB	_d, CCPR1L

; C:\USERS\JESSADA\DESKTOP\LED DIMMER PROJECT\PIC16F886\MB_STDIM.BAS	00302	Z00051						hserout [d]
Z00051
	HSEROUT?B	_d

; C:\USERS\JESSADA\DESKTOP\LED DIMMER PROJECT\PIC16F886\MB_STDIM.BAS	00303	Z00052					next j
Z00052
	NEXT?BCL	_j, 001h, L00017
	LABEL?L	L00018	

; C:\USERS\JESSADA\DESKTOP\LED DIMMER PROJECT\PIC16F886\MB_STDIM.BAS	00306	Z00053				endif
Z00053
	LABEL?L	L00015	

; C:\USERS\JESSADA\DESKTOP\LED DIMMER PROJECT\PIC16F886\MB_STDIM.BAS	00310	Z00054			endif
Z00054
	LABEL?L	L00013	

; C:\USERS\JESSADA\DESKTOP\LED DIMMER PROJECT\PIC16F886\MB_STDIM.BAS	00312	Z00055			goto start
Z00055
	GOTO?L	_start

; C:\USERS\JESSADA\DESKTOP\LED DIMMER PROJECT\PIC16F886\MB_STDIM.BAS	00317	Z00056	cktmOut:
Z00056

	LABEL?L	_cktmOut	

; C:\USERS\JESSADA\DESKTOP\LED DIMMER PROJECT\PIC16F886\MB_STDIM.BAS	00318	Z00057		Rpt=0 :if (TMR1IF) then Rpt=1
Z00057
	MOVE?CB	000h, _Rpt

; C:\USERS\JESSADA\DESKTOP\LED DIMMER PROJECT\PIC16F886\MB_STDIM.BAS	00318	Z00058		Rpt=0 :if (TMR1IF) then Rpt=1
Z00058
	CMPF?TL	_TMR1IF, L00019
	MOVE?CB	001h, _Rpt
	LABEL?L	L00019	

; C:\USERS\JESSADA\DESKTOP\LED DIMMER PROJECT\PIC16F886\MB_STDIM.BAS	00319	Z00059		debug 13,10,"found TMR1IF", TMR1IF, 13,10   	
Z00059
	DEBUG?C	00Dh
	DEBUG?C	00Ah
	DEBUG?C	066h
	DEBUG?C	06Fh
	DEBUG?C	075h
	DEBUG?C	06Eh
	DEBUG?C	064h
	DEBUG?C	020h
	DEBUG?C	054h
	DEBUG?C	04Dh
	DEBUG?C	052h
	DEBUG?C	031h
	DEBUG?C	049h
	DEBUG?C	046h
	DEBUG?T	_TMR1IF
	DEBUG?C	00Dh
	DEBUG?C	00Ah

; C:\USERS\JESSADA\DESKTOP\LED DIMMER PROJECT\PIC16F886\MB_STDIM.BAS	00320	Z0005A		return
Z0005A
	RETURN?	

; C:\USERS\JESSADA\DESKTOP\LED DIMMER PROJECT\PIC16F886\MB_STDIM.BAS	00325	Z0005B	init_PWM:
Z0005B

	LABEL?L	_init_PWM	

; C:\USERS\JESSADA\DESKTOP\LED DIMMER PROJECT\PIC16F886\MB_STDIM.BAS	00329	Z0005C		CCP1CON=%00001100	;            0     0    d       d       1       1      0       0			;SET MODE PWM
Z0005C
	MOVE?CB	00Ch, CCP1CON

; C:\USERS\JESSADA\DESKTOP\LED DIMMER PROJECT\PIC16F886\MB_STDIM.BAS	00330	Z0005D		CCPR1L=$00			;high 8 bits
Z0005D
	MOVE?CB	000h, CCPR1L

; C:\USERS\JESSADA\DESKTOP\LED DIMMER PROJECT\PIC16F886\MB_STDIM.BAS	00334	Z0005E		T2CON=$07
Z0005E
	MOVE?CB	007h, T2CON

; C:\USERS\JESSADA\DESKTOP\LED DIMMER PROJECT\PIC16F886\MB_STDIM.BAS	00335	Z0005F		PR2=$ff
Z0005F
	MOVE?CB	0FFh, PR2

; C:\USERS\JESSADA\DESKTOP\LED DIMMER PROJECT\PIC16F886\MB_STDIM.BAS	00337	Z00060		return
Z00060
	RETURN?	

; C:\USERS\JESSADA\DESKTOP\LED DIMMER PROJECT\PIC16F886\MB_STDIM.BAS	00342	Z00061	init_IO:
Z00061

	LABEL?L	_init_IO	

; C:\USERS\JESSADA\DESKTOP\LED DIMMER PROJECT\PIC16F886\MB_STDIM.BAS	00346	Z00062		ANSEL  = %00000000			; for port a (digital I/O)
Z00062
	MOVE?CB	000h, ANSEL

; C:\USERS\JESSADA\DESKTOP\LED DIMMER PROJECT\PIC16F886\MB_STDIM.BAS	00347	Z00063		TRISA  = %00100111   		; port a
Z00063
	MOVE?CB	027h, TRISA

; C:\USERS\JESSADA\DESKTOP\LED DIMMER PROJECT\PIC16F886\MB_STDIM.BAS	00350	Z00064		TRISB  = %00000000   		; port b
Z00064
	MOVE?CB	000h, TRISB

; C:\USERS\JESSADA\DESKTOP\LED DIMMER PROJECT\PIC16F886\MB_STDIM.BAS	00351	Z00065		ANSELH = %00000000			; Need to be initialize for port b
Z00065
	MOVE?CB	000h, ANSELH

; C:\USERS\JESSADA\DESKTOP\LED DIMMER PROJECT\PIC16F886\MB_STDIM.BAS	00354	Z00066		TRISC  = %10000000   		; port b
Z00066
	MOVE?CB	080h, TRISC

; C:\USERS\JESSADA\DESKTOP\LED DIMMER PROJECT\PIC16F886\MB_STDIM.BAS	00355	Z00067		TRISC.7 =1					;receive pin
Z00067
	MOVE?CT	001h, _TRISC??7

; C:\USERS\JESSADA\DESKTOP\LED DIMMER PROJECT\PIC16F886\MB_STDIM.BAS	00356	Z00068	  	TRISC.6 =0	 				;transmit pin
Z00068
	MOVE?CT	000h, _TRISC??6

; C:\USERS\JESSADA\DESKTOP\LED DIMMER PROJECT\PIC16F886\MB_STDIM.BAS	00357	Z00069		debug 13,10,"init IO",13,10
Z00069
	DEBUG?C	00Dh
	DEBUG?C	00Ah
	DEBUG?C	069h
	DEBUG?C	06Eh
	DEBUG?C	069h
	DEBUG?C	074h
	DEBUG?C	020h
	DEBUG?C	049h
	DEBUG?C	04Fh
	DEBUG?C	00Dh
	DEBUG?C	00Ah

; C:\USERS\JESSADA\DESKTOP\LED DIMMER PROJECT\PIC16F886\MB_STDIM.BAS	00359	Z0006A		return
Z0006A
	RETURN?	

; C:\USERS\JESSADA\DESKTOP\LED DIMMER PROJECT\PIC16F886\MB_STDIM.BAS	00363	Z0006B	init_EUSART:
Z0006B

	LABEL?L	_init_EUSART	

; C:\USERS\JESSADA\DESKTOP\LED DIMMER PROJECT\PIC16F886\MB_STDIM.BAS	00365	Z0006C		RCSTA = $90   ' Enable serial port & continuous receive
Z0006C
	MOVE?CB	090h, RCSTA

; C:\USERS\JESSADA\DESKTOP\LED DIMMER PROJECT\PIC16F886\MB_STDIM.BAS	00366	Z0006D		TXSTA = $24   ' Enable transmit, BRGH = 1
Z0006D
	MOVE?CB	024h, TXSTA

; C:\USERS\JESSADA\DESKTOP\LED DIMMER PROJECT\PIC16F886\MB_STDIM.BAS	00367	Z0006E		SPBRG = 8     ' 9600 Baud @ 20MHz, -0.03%
Z0006E
	MOVE?CB	008h, SPBRG

; C:\USERS\JESSADA\DESKTOP\LED DIMMER PROJECT\PIC16F886\MB_STDIM.BAS	00368	Z0006F		SPBRGH = 2
Z0006F
	MOVE?CB	002h, SPBRGH

; C:\USERS\JESSADA\DESKTOP\LED DIMMER PROJECT\PIC16F886\MB_STDIM.BAS	00369	Z00070		BAUDCTL.3 = 1 ' Enable 16 bit baudrate generator
Z00070
	MOVE?CT	001h, _BAUDCTL??3

; C:\USERS\JESSADA\DESKTOP\LED DIMMER PROJECT\PIC16F886\MB_STDIM.BAS	00372	Z00071		debug 13,10,"EUSART Initialized",13,10
Z00071
	DEBUG?C	00Dh
	DEBUG?C	00Ah
	DEBUG?C	045h
	DEBUG?C	055h
	DEBUG?C	053h
	DEBUG?C	041h
	DEBUG?C	052h
	DEBUG?C	054h
	DEBUG?C	020h
	DEBUG?C	049h
	DEBUG?C	06Eh
	DEBUG?C	069h
	DEBUG?C	074h
	DEBUG?C	069h
	DEBUG?C	061h
	DEBUG?C	06Ch
	DEBUG?C	069h
	DEBUG?C	07Ah
	DEBUG?C	065h
	DEBUG?C	064h
	DEBUG?C	00Dh
	DEBUG?C	00Ah

; C:\USERS\JESSADA\DESKTOP\LED DIMMER PROJECT\PIC16F886\MB_STDIM.BAS	00373	Z00072		return
Z00072
	RETURN?	

; C:\USERS\JESSADA\DESKTOP\LED DIMMER PROJECT\PIC16F886\MB_STDIM.BAS	00376	Z00073	OnTm1:				; 20 mhz
Z00073

	LABEL?L	_OnTm1	

; C:\USERS\JESSADA\DESKTOP\LED DIMMER PROJECT\PIC16F886\MB_STDIM.BAS	00379	Z00074		T1CON=%00100101			;
Z00074
	MOVE?CB	025h, T1CON

; C:\USERS\JESSADA\DESKTOP\LED DIMMER PROJECT\PIC16F886\MB_STDIM.BAS	00380	Z00075		TMR1H=$f6 :TMR1L=$40	; 1ms *** [preload=63040]	use Timer Helper select fosc=20 mhz, reload instr=8,interrupt = 1ms,prescale 1:2
Z00075
	MOVE?CB	0F6h, TMR1H

; C:\USERS\JESSADA\DESKTOP\LED DIMMER PROJECT\PIC16F886\MB_STDIM.BAS	00380	Z00076		TMR1H=$f6 :TMR1L=$40	; 1ms *** [preload=63040]	use Timer Helper select fosc=20 mhz, reload instr=8,interrupt = 1ms,prescale 1:2
Z00076
	MOVE?CB	040h, TMR1L

; C:\USERS\JESSADA\DESKTOP\LED DIMMER PROJECT\PIC16F886\MB_STDIM.BAS	00382	Z00077		low TMR1IF				; clr flag
Z00077
	LOW?T	_TMR1IF

; C:\USERS\JESSADA\DESKTOP\LED DIMMER PROJECT\PIC16F886\MB_STDIM.BAS	00383	Z00078		high TMR1ON				; timer1 on
Z00078
	HIGH?T	_TMR1ON

; C:\USERS\JESSADA\DESKTOP\LED DIMMER PROJECT\PIC16F886\MB_STDIM.BAS	00384	Z00079		return
Z00079
	RETURN?	

; C:\USERS\JESSADA\DESKTOP\LED DIMMER PROJECT\PIC16F886\MB_STDIM.BAS	00392	Z0007A	@        __config _CONFIG1, 239AH	
Z0007A

	ASM?
        __config _CONFIG1, 239AH	

	ENDASM?


; C:\USERS\JESSADA\DESKTOP\LED DIMMER PROJECT\PIC16F886\MB_STDIM.BAS	00393	Z0007B	@        __config _CONFIG2, 3EFFH
Z0007B

	ASM?
        __config _CONFIG2, 3EFFH

	ENDASM?


; C:\USERS\JESSADA\DESKTOP\LED DIMMER PROJECT\PIC16F886\MB_STDIM.BAS	00397	Z0007C		END                     ' End of program
Z0007C
	END?	

	END
